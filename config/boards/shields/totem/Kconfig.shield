## config/boards/shields/totem/Kconfig.shield
```kconfig
config SHIELD_TOTEM_LEFT
    def_bool $(shields_list_contains,totem_left)

config SHIELD_TOTEMV2_RIGHT
    def_bool $(shields_list_contains,totem_right)
```
